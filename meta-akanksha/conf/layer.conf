## meta-akanksha/conf/layer.conf
```bitbake
# We have a conf and classes directory, add to BBPATH
BBPATH .= ":${LAYERDIR}"

# We have recipes-* directories, add to BBFILES
BBFILES += "${LAYERDIR}/recipes-*/*/*.bb \
            ${LAYERDIR}/recipes-*/*/*.bbappend"

BBFILE_COLLECTIONS += "meta-akanksha"
BBFILE_PATTERN_meta-akanksha = "^${LAYERDIR}/"
BBFILE_PRIORITY_meta-akanksha = "6"

LAYERDEPENDS_meta-akanksha = "core"
LAYERSERIES_COMPAT_meta-akanksha = "wrynose"
```
